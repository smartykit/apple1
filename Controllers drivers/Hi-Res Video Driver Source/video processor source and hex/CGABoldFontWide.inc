;******************************************************
; COMPLETE CGA BOLD FONT - WIDE VERSERION
;
; Extracted by Grant Searle 2013
;******************************************************
.CSEG
.ORG 0x2800

; 40 Char / line font (double width) left half of each char

; Character line 0:
;     0     1     2     3     4     5     6     7     8     9    10    11    12    13    14    15
.db  0x00, 0x3F, 0x3F, 0x3C, 0x03, 0x0F, 0x03, 0x00, 0xFF, 0x00, 0xFF, 0x00, 0x0F, 0x0F, 0x3F, 0x03
.db  0xC0, 0x00, 0x03, 0x3C, 0x3F, 0x0F, 0x00, 0x03, 0x03, 0x03, 0x00, 0x00, 0x00, 0x00, 0x00, 0x00
.db  0x00, 0x0F, 0x3C, 0x3C, 0x0F, 0x00, 0x0F, 0x3C, 0x03, 0x3C, 0x00, 0x00, 0x00, 0x00, 0x00, 0x00
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.db  0x00, 0x0F, 0x3C, 0x03, 0x00, 0x03, 0x0F, 0x00, 0x0F, 0x00, 0x00, 0x00, 0x3F, 0x3F, 0x00, 0x00

; Character line 1:
;     0     1     2     3     4     5     6     7     8     9    10    11    12    13    14    15
.db  0x00, 0xC0, 0xFF, 0xFF, 0x0F, 0x3F, 0x03, 0x00, 0xFF, 0x0F, 0xF0, 0x00, 0x3C, 0x0F, 0x3C, 0xF3
.db  0xFC, 0x00, 0x0F, 0x3C, 0xF3, 0x3C, 0x00, 0x0F, 0x0F, 0x03, 0x03, 0x0F, 0x00, 0x0C, 0x03, 0xFF
.db  0x00, 0x3F, 0x3C, 0x3C, 0x3F, 0xF0, 0x3C, 0x3C, 0x0F, 0x0F, 0x3C, 0x0F, 0x00, 0x00, 0x00, 0x00
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.db  0xFF, 0x0F, 0x0F, 0x0F, 0x03, 0x03, 0x0F, 0x3F, 0x3C, 0x00, 0x00, 0x00, 0x3C, 0x03, 0x00, 0x00

; Character line 2:
;     0     1     2     3     4     5     6     7     8     9    10    11    12    13    14    15
.db  0x00, 0xCC, 0xF3, 0xFF, 0x3F, 0x0F, 0x0F, 0x03, 0xFC, 0x3C, 0xC3, 0x00, 0x3C, 0x0F, 0x3F, 0x0F
.db  0xFF, 0x0F, 0x3F, 0x3C, 0xF3, 0x0F, 0x00, 0x3F, 0x3F, 0x03, 0x00, 0x3C, 0xF0, 0x3C, 0x0F, 0xFF
.db  0x00, 0x3F, 0x3C, 0xFF, 0xF0, 0xF0, 0x0F, 0xF0, 0x3C, 0x03, 0x0F, 0x0F, 0x00, 0x00, 0x00, 0x03
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.db  0x00, 0xFF, 0x03, 0x3C, 0x03, 0x03, 0x00, 0xF3, 0x3C, 0x00, 0x00, 0x00, 0x3C, 0x0F, 0x0F, 0x00

; Character line 3:
;     0     1     2     3     4     5     6     7     8     9    10    11    12    13    14    15
.db  0x00, 0xC0, 0xFF, 0xFF, 0xFF, 0xFF, 0x3F, 0x0F, 0xF0, 0x30, 0xCF, 0x3F, 0x3C, 0x0F, 0x3C, 0xFC
.db  0xFF, 0xFF, 0x03, 0x3C, 0x3F, 0x3C, 0x00, 0x03, 0x03, 0x03, 0xFF, 0xFF, 0xF0, 0xFF, 0x3F, 0x3F
.db  0x00, 0x0F, 0x00, 0x3C, 0x3F, 0x03, 0x3F, 0x00, 0x3C, 0x03, 0xFF, 0xFF, 0x00, 0xFF, 0x00, 0x0F
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.db  0xFF, 0x0F, 0x0F, 0x0F, 0x03, 0x03, 0xFF, 0x00, 0x0F, 0x03, 0x00, 0x00, 0x3C, 0x3C, 0x0F, 0x00

; Character line 4:
;     0     1     2     3     4     5     6     7     8     9    10    11    12    13    14    15
.db  0x00, 0xCF, 0xF0, 0x3F, 0x3F, 0xFF, 0xFF, 0x0F, 0xF0, 0x30, 0xCF, 0xF0, 0x0F, 0x0F, 0x3C, 0xFC
.db  0xFF, 0x0F, 0x03, 0x3C, 0x03, 0x3C, 0x3F, 0x3F, 0x03, 0x3F, 0x00, 0x3C, 0xF0, 0x3C, 0xFF, 0x0F
.db  0x00, 0x0F, 0x00, 0xFF, 0x00, 0x0F, 0xF3, 0x00, 0x3C, 0x03, 0x0F, 0x0F, 0x00, 0x00, 0x00, 0x3C
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.db  0x00, 0x0F, 0x3C, 0x03, 0x03, 0x03, 0x00, 0x3F, 0x00, 0x03, 0x03, 0xFC, 0x3C, 0x3F, 0x0F, 0x00

; Character line 5:
;     0     1     2     3     4     5     6     7     8     9    10    11    12    13    14    15
.db  0x00, 0xC3, 0xFC, 0x0F, 0x0F, 0xF3, 0x3F, 0x03, 0xFC, 0x3C, 0xC3, 0xF0, 0x03, 0x3F, 0x3C, 0x0F
.db  0xFC, 0x00, 0x3F, 0x00, 0x03, 0x0F, 0x3F, 0x0F, 0x03, 0x0F, 0x03, 0x0F, 0xFF, 0x0C, 0xFF, 0x03
.db  0x00, 0x00, 0x00, 0x3C, 0xFF, 0x3C, 0xF0, 0x00, 0x0F, 0x0F, 0x3C, 0x0F, 0x0F, 0x00, 0x0F, 0xF0
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.db  0xFF, 0x00, 0x00, 0x00, 0x03, 0xF3, 0x0F, 0xF3, 0x00, 0x00, 0x00, 0x3C, 0x00, 0x00, 0x0F, 0x00

; Character line 6:
;     0     1     2     3     4     5     6     7     8     9    10    11    12    13    14    15
.db  0x00, 0xC0, 0xFF, 0x03, 0x03, 0x03, 0x03, 0x00, 0xFF, 0x0F, 0xF0, 0xF0, 0x3F, 0xFF, 0xFC, 0xF3
.db  0xC0, 0x00, 0x0F, 0x3C, 0x03, 0xF0, 0x3F, 0x03, 0x03, 0x03, 0x00, 0x00, 0x00, 0x00, 0x00, 0x00
.db  0x00, 0x0F, 0x00, 0x3C, 0x0F, 0xF0, 0x3F, 0x00, 0x03, 0x3C, 0x00, 0x00, 0x0F, 0x00, 0x0F, 0xC0
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.db  0x00, 0xFF, 0xFF, 0xFF, 0x03, 0xF3, 0x0F, 0x00, 0x00, 0x00, 0x00, 0x0F, 0x00, 0x00, 0x00, 0x00

; Character line 7:
;     0     1     2     3     4     5     6     7     8     9    10    11    12    13    14    15
.db  0x00, 0x3F, 0x3F, 0x00, 0x00, 0x0F, 0x0F, 0x00, 0xFF, 0x00, 0xFF, 0x3F, 0x03, 0xFC, 0xF0, 0x03
.db  0x00, 0x00, 0x03, 0x00, 0x00, 0x3F, 0x00, 0xFF, 0x00, 0x00, 0x00, 0x00, 0x00, 0x00, 0x00, 0x00
.db  0x00, 0x00, 0x00, 0x00, 0x00, 0x00, 0x00, 0x00, 0x00, 0x00, 0x00, 0x00, 0x3C, 0x00, 0x00, 0x00
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.db  0x00, 0x00, 0x00, 0x00, 0x03, 0x3F, 0x00, 0x00, 0x00, 0x00, 0x00, 0x03, 0x00, 0x00, 0x00, 0x00


; 40 Char / line font (double width) right half of each char

; Character line 0:
;     0     1     2     3     4     5     6     7     8     9    10    11    12    13    14    15
.db  0x00, 0xFC, 0xFC, 0xF0, 0x00, 0xC0, 0x00, 0x00, 0xFF, 0x00, 0xFF, 0xFF, 0xF0, 0xFF, 0xFF, 0xC0
.db  0x00, 0x0C, 0xC0, 0x3C, 0xFF, 0xFC, 0x00, 0xC0, 0xC0, 0xC0, 0x00, 0x00, 0x00, 0x00, 0x00, 0x00
.db  0x00, 0x00, 0xF0, 0xF0, 0x00, 0x00, 0xC0, 0x00, 0xC0, 0x00, 0x00, 0x00, 0x00, 0x00, 0x00, 0x3C
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.db  0x00, 0x00, 0x00, 0xC0, 0xFC, 0xC0, 0x00, 0x00, 0xC0, 0x00, 0x00, 0xFF, 0xC0, 0x00, 0x00, 0x00

; Character line 1:
;     0     1     2     3     4     5     6     7     8     9    10    11    12    13    14    15
.db  0x00, 0x03, 0xFF, 0xFC, 0xC0, 0xF0, 0x00, 0x00, 0xFF, 0xF0, 0x0F, 0x3F, 0x3C, 0x0F, 0x0F, 0xCF
.db  0x00, 0xFC, 0xF0, 0x3C, 0xCF, 0x0F, 0x00, 0xF0, 0xF0, 0xC0, 0xC0, 0x00, 0x00, 0x30, 0xC0, 0xFF
.db  0x00, 0xC0, 0xF0, 0xF0, 0xF0, 0x3C, 0xF0, 0x00, 0x00, 0x00, 0x3C, 0x00, 0x00, 0x00, 0x00, 0xF0
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.db  0xF0, 0x00, 0x00, 0x00, 0xCF, 0xC0, 0x00, 0x3C, 0xF0, 0x00, 0x00, 0xF0, 0xF0, 0xC0, 0x00, 0x00

; Character line 2:
;     0     1     2     3     4     5     6     7     8     9    10    11    12    13    14    15
.db  0x00, 0x33, 0xCF, 0xFC, 0xF0, 0xC0, 0xC0, 0xC0, 0x3F, 0x3C, 0xC3, 0xFF, 0x3C, 0xFF, 0xFF, 0xF0
.db  0xC0, 0xFC, 0xFC, 0x3C, 0xCF, 0xC0, 0x00, 0xFC, 0xFC, 0xC0, 0xF0, 0x00, 0x00, 0x3C, 0xF0, 0xFF
.db  0x00, 0xC0, 0xF0, 0xFC, 0x00, 0xF0, 0xC0, 0x00, 0x00, 0xC0, 0xF0, 0x00, 0x00, 0x00, 0x00, 0xC0
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.db  0x00, 0xF0, 0xC0, 0x00, 0xCF, 0xC0, 0x00, 0xF0, 0xF0, 0x00, 0x00, 0xF0, 0xF0, 0x00, 0xF0, 0x00

; Character line 3:
;     0     1     2     3     4     5     6     7     8     9    10    11    12    13    14    15
.db  0x00, 0x03, 0xFF, 0xFC, 0xFC, 0xFC, 0xF0, 0xF0, 0x0F, 0x0C, 0xF3, 0xF3, 0x3C, 0x00, 0x0F, 0x3F
.db  0xFC, 0xFC, 0xC0, 0x3C, 0xCF, 0xF0, 0x00, 0xC0, 0xC0, 0xC0, 0xFC, 0xFC, 0x00, 0xFF, 0xFC, 0xFC
.db  0x00, 0x00, 0x00, 0xF0, 0xC0, 0xC0, 0x3C, 0x00, 0x00, 0xC0, 0xFF, 0xF0, 0x00, 0xF0, 0x00, 0x00
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.db  0xF0, 0x00, 0x00, 0x00, 0xC0, 0xC0, 0xF0, 0x00, 0xC0, 0xC0, 0x00, 0xF0, 0xF0, 0x00, 0xF0, 0x00

; Character line 4:
;     0     1     2     3     4     5     6     7     8     9    10    11    12    13    14    15
.db  0x00, 0xF3, 0x0F, 0xF0, 0xF0, 0xFC, 0xFC, 0xF0, 0x0F, 0x0C, 0xF3, 0xF0, 0xF0, 0x00, 0x0F, 0x3F
.db  0xC0, 0xFC, 0xC0, 0x3C, 0xCF, 0xF0, 0xFC, 0xFC, 0xC0, 0xFC, 0xF0, 0x00, 0x00, 0x3C, 0xFF, 0xF0
.db  0x00, 0x00, 0x00, 0xFC, 0xF0, 0x00, 0xF0, 0x00, 0x00, 0xC0, 0xF0, 0x00, 0x00, 0x00, 0x00, 0x00
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.db  0x00, 0x00, 0x00, 0xC0, 0xC0, 0xC0, 0x00, 0x3C, 0x00, 0xC0, 0xC0, 0xF0, 0xF0, 0xC0, 0xF0, 0x00

; Character line 5:
;     0     1     2     3     4     5     6     7     8     9    10    11    12    13    14    15
.db  0x00, 0xC3, 0x3F, 0xC0, 0xC0, 0x3C, 0xF0, 0xC0, 0x3F, 0x3C, 0xC3, 0xF0, 0xC0, 0x00, 0x3F, 0xF0
.db  0x00, 0xFC, 0xFC, 0x00, 0xCF, 0xC0, 0xFC, 0xF0, 0xC0, 0xF0, 0xC0, 0x00, 0xFC, 0x30, 0xFF, 0xC0
.db  0x00, 0x00, 0x00, 0xF0, 0xC0, 0x3C, 0xF0, 0x00, 0x00, 0x00, 0x3C, 0x00, 0x00, 0x00, 0x00, 0x00
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.db  0xF0, 0x00, 0x00, 0x00, 0xC0, 0xC0, 0x00, 0xF0, 0x00, 0x00, 0x00, 0xF0, 0x00, 0x00, 0xF0, 0x00

; Character line 6:
;     0     1     2     3     4     5     6     7     8     9    10    11    12    13    14    15
.db  0x00, 0x03, 0xFF, 0x00, 0x00, 0x00, 0x00, 0x00, 0xFF, 0xF0, 0x0F, 0xF0, 0xFC, 0x00, 0x3C, 0xCF
.db  0x00, 0x0C, 0xF0, 0x3C, 0xCF, 0xF0, 0xFC, 0xC0, 0xC0, 0xC0, 0x00, 0x00, 0x00, 0x00, 0x00, 0x00
.db  0x00, 0x00, 0x00, 0xF0, 0x00, 0x3C, 0x3C, 0x00, 0xC0, 0x00, 0x00, 0x00, 0x00, 0x00, 0x00, 0x00
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.db  0x00, 0xF0, 0xF0, 0xF0, 0xC0, 0xC0, 0x00, 0x00, 0x00, 0x00, 0x00, 0xF0, 0x00, 0x00, 0x00, 0x00

; Character line 7:
;     0     1     2     3     4     5     6     7     8     9    10    11    12    13    14    15
.db  0x00, 0xFC, 0xFC, 0x00, 0x00, 0xC0, 0xC0, 0x00, 0xFF, 0x00, 0xFF, 0xC0, 0xC0, 0x00, 0x00, 0xC0
.db  0x00, 0x00, 0xC0, 0x00, 0x00, 0xC0, 0x00, 0xFF, 0x00, 0x00, 0x00, 0x00, 0x00, 0x00, 0x00, 0x00
.db  0x00, 0x00, 0x00, 0x00, 0x00, 0x00, 0x00, 0x00, 0x00, 0x00, 0x00, 0x00, 0x00, 0x00, 0x00, 0x00
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.db  0x00, 0x00, 0x00, 0x00, 0xC0, 0x00, 0x00, 0x00, 0x00, 0x00, 0x00, 0xF0, 0x00, 0x00, 0x00, 0x00
